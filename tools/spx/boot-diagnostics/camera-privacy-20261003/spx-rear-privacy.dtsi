// SPDX-License-Identifier: GPL-2.0-only
/* Offline candidate: SQ2 CAMP.PRLD, decoded with retained vendor parser. */
#include <dt-bindings/gpio/gpio.h>

/ {
	spx_camera_privacy: camera-privacy-leds {
		compatible = "gpio-leds";

		spx_rear_privacy: led-0 {
			label = "spx:rear:privacy";
			gpios = <&tlmm 11 GPIO_ACTIVE_HIGH>;
			default-state = "off";
		};
	};
};

&{/soc@0/cci@ac4a000/i2c-bus@0/camera@10} {
	leds = <&spx_rear_privacy>;
	led-names = "privacy";
};
