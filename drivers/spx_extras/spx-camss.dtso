// SPDX-License-Identifier: GPL-2.0
/*
 * Surface Pro X (sc8180x) CAMSS overlay — topology scaffold only.
 *
 * The fully validated combined tree is docs/camdtb/v22.dts.  On 2026-08-09
 * it captured both the CSID generator and real OV5693 frames.  Do not deploy
 * this older standalone scaffold without first synchronizing its CSIPHY
 * windows and board endpoints with that tree.
 *
 * sc8180x carries the same Titan 480 CAMSS as sc8280xp. Evidence: the SPX
 * DSDT ACPI devices CAMP (QCOM0435), MPCS (QCOM04A4) and VFE0 (QCOM0428)
 * list 4 CSIPHY blocks (0xac5a000, 0xac65000..0xac68000) and 8 CSID/VFE
 * pairs at 0xacaf000, 0xacb6000, 0xacbd000, 0xacc4000, 0xaccb000,
 * 0xacd2000, 0xacd9000, 0xace0000 — the same map sc8280xp.dtsi uses.
 * camcc-sc8180x exposes exactly the matching clock set (4x IFE,
 * 4x IFE_LITE, 4x CSIPHY), which corroborates the match.
 *
 * OPEN: the interrupt ordering below is derived from the ACPI GSIVs
 * (SPI = GSIV - 32) but the GSIV-to-block mapping is not yet confirmed,
 * and no sensor nodes are present — the board wiring (CCI bus, MCLK,
 * reset GPIOs, regulators) is still unknown. This overlay therefore
 * brings up the ISP only; it cannot capture yet.
 */

/dts-v1/;
/plugin/;

#include <dt-bindings/clock/qcom,sc8180x-camcc.h>
#include <dt-bindings/clock/qcom,gcc-sc8180x.h>
#include <dt-bindings/interrupt-controller/arm-gic.h>

&{/soc@0} {
	spx_camss: camss@ac5a000 {
		compatible = "qcom,sc8180x-camss";
		/* qcsmmu8180.inf: VFE CB21, S1_CAMERA_HLOS. */
		iommus = <&apps_smmu 0x0a00 0x04e0>;

		reg = <0 0x0ac5a000 0 0x2000>,
		      <0 0x0ac5c000 0 0x2000>,
		      <0 0x0ac65000 0 0x2000>,
		      <0 0x0ac67000 0 0x2000>,
		      <0 0x0acaf000 0 0x4000>,
		      <0 0x0acb3000 0 0x1000>,
		      <0 0x0acb6000 0 0x4000>,
		      <0 0x0acba000 0 0x1000>,
		      <0 0x0acbd000 0 0x4000>,
		      <0 0x0acc1000 0 0x1000>,
		      <0 0x0acc4000 0 0x4000>,
		      <0 0x0acc8000 0 0x1000>,
		      <0 0x0accb000 0 0x4000>,
		      <0 0x0accf000 0 0x1000>,
		      <0 0x0acd2000 0 0x4000>,
		      <0 0x0acd6000 0 0x1000>,
		      <0 0x0acd9000 0 0x4000>,
		      <0 0x0acdd000 0 0x1000>,
		      <0 0x0ace0000 0 0x4000>,
		      <0 0x0ace4000 0 0x1000>;
		reg-names = "csiphy2", "csiphy3", "csiphy0", "csiphy1",
			    "vfe0", "csid0", "vfe1", "csid1",
			    "vfe2", "csid2",
			    "vfe_lite0", "csid0_lite",
			    "vfe_lite1", "csid1_lite",
			    "vfe_lite2", "csid2_lite",
			    "vfe_lite3", "csid3_lite",
			    "vfe3", "csid3";

		power-domains = <&camcc IFE_0_GDSC>,
				<&camcc IFE_1_GDSC>,
				<&camcc IFE_2_GDSC>,
				<&camcc IFE_3_GDSC>,
				<&camcc TITAN_TOP_GDSC>;
		power-domain-names = "ife0", "ife1", "ife2", "ife3", "top";

		clocks = <&camcc CAM_CC_CAMNOC_AXI_CLK>,
			 <&camcc CAM_CC_CPAS_AHB_CLK>,
			 <&camcc CAM_CC_CSIPHY0_CLK>,
			 <&camcc CAM_CC_CSI0PHYTIMER_CLK>,
			 <&camcc CAM_CC_CSIPHY1_CLK>,
			 <&camcc CAM_CC_CSI1PHYTIMER_CLK>,
			 <&camcc CAM_CC_CSIPHY2_CLK>,
			 <&camcc CAM_CC_CSI2PHYTIMER_CLK>,
			 <&camcc CAM_CC_CSIPHY3_CLK>,
			 <&camcc CAM_CC_CSI3PHYTIMER_CLK>,
			 <&camcc CAM_CC_IFE_0_AXI_CLK>,
			 <&camcc CAM_CC_IFE_0_CLK>,
			 <&camcc CAM_CC_IFE_0_CPHY_RX_CLK>,
			 <&camcc CAM_CC_IFE_0_CSID_CLK>,
			 <&camcc CAM_CC_IFE_1_AXI_CLK>,
			 <&camcc CAM_CC_IFE_1_CLK>,
			 <&camcc CAM_CC_IFE_1_CPHY_RX_CLK>,
			 <&camcc CAM_CC_IFE_1_CSID_CLK>,
			 <&camcc CAM_CC_IFE_2_AXI_CLK>,
			 <&camcc CAM_CC_IFE_2_CLK>,
			 <&camcc CAM_CC_IFE_2_CPHY_RX_CLK>,
			 <&camcc CAM_CC_IFE_2_CSID_CLK>,
			 <&camcc CAM_CC_IFE_3_AXI_CLK>,
			 <&camcc CAM_CC_IFE_3_CLK>,
			 <&camcc CAM_CC_IFE_3_CPHY_RX_CLK>,
			 <&camcc CAM_CC_IFE_3_CSID_CLK>,
			 <&camcc CAM_CC_IFE_LITE_0_CLK>,
			 <&camcc CAM_CC_IFE_LITE_0_CPHY_RX_CLK>,
			 <&camcc CAM_CC_IFE_LITE_0_CSID_CLK>,
			 <&camcc CAM_CC_IFE_LITE_1_CLK>,
			 <&camcc CAM_CC_IFE_LITE_1_CPHY_RX_CLK>,
			 <&camcc CAM_CC_IFE_LITE_1_CSID_CLK>,
			 <&camcc CAM_CC_IFE_LITE_2_CLK>,
			 <&camcc CAM_CC_IFE_LITE_2_CPHY_RX_CLK>,
			 <&camcc CAM_CC_IFE_LITE_2_CSID_CLK>,
			 <&camcc CAM_CC_IFE_LITE_3_CLK>,
			 <&camcc CAM_CC_IFE_LITE_3_CPHY_RX_CLK>,
			 <&camcc CAM_CC_IFE_LITE_3_CSID_CLK>,
			 <&gcc GCC_CAMERA_HF_AXI_CLK>,
			 <&gcc GCC_CAMERA_SF_AXI_CLK>;
		clock-names = "camnoc_axi", "cpas_ahb",
			      "csiphy0", "csiphy0_timer",
			      "csiphy1", "csiphy1_timer",
			      "csiphy2", "csiphy2_timer",
			      "csiphy3", "csiphy3_timer",
			      "vfe0_axi", "vfe0", "vfe0_cphy_rx", "vfe0_csid",
			      "vfe1_axi", "vfe1", "vfe1_cphy_rx", "vfe1_csid",
			      "vfe2_axi", "vfe2", "vfe2_cphy_rx", "vfe2_csid",
			      "vfe3_axi", "vfe3", "vfe3_cphy_rx", "vfe3_csid",
			      "vfe_lite0", "vfe_lite0_cphy_rx", "vfe_lite0_csid",
			      "vfe_lite1", "vfe_lite1_cphy_rx", "vfe_lite1_csid",
			      "vfe_lite2", "vfe_lite2_cphy_rx", "vfe_lite2_csid",
			      "vfe_lite3", "vfe_lite3_cphy_rx", "vfe_lite3_csid",
			      "gcc_axi_hf", "gcc_axi_sf";

		status = "okay";
	};
};
