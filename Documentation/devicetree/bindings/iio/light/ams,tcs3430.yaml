## Documentation/devicetree/bindings/iio/light/ams,tcs3430.yaml
```yaml
# SPDX-License-Identifier: (GPL-2.0-only OR BSD-2-Clause)
%YAML 1.2
---
$id: http://devicetree.org/schemas/iio/light/ams,tcs3430.yaml#
$schema: http://devicetree.org/meta-schemas/core.yaml#

title: AMS TCS3430 color and ambient light sensor

maintainers:
  - Denys Vitali <denys@denv.it>

description: |
  I2C color sensor with CIE XYZ and infrared channels. The device has no
  proximity or gesture engine.

properties:
  compatible:
    const: ams,tcs3430

  reg:
    maxItems: 1

  interrupts:
    maxItems: 1

required:
  - compatible
  - reg

additionalProperties: false

examples:
  - |
    #include <dt-bindings/interrupt-controller/irq.h>

    i2c {
        #address-cells = <1>;
        #size-cells = <0>;

        light-sensor@39 {
            compatible = "ams,tcs3430";
            reg = <0x39>;
            interrupt-parent = <&gpio>;
            interrupts = <24 IRQ_TYPE_LEVEL_LOW>;
        };
    };
```

## Documentation/devicetree/bindings/media/qcom,sc8180x-venus.yaml
```yaml
# SPDX-License-Identifier: (GPL-2.0 OR BSD-2-Clause)
%YAML 1.2
---
$id: http://devicetree.org/schemas/media/qcom,sc8180x-venus.yaml#
$schema: http://devicetree.org/meta-schemas/core.yaml#

title: Qualcomm SC8180X Iris1 video encode and decode accelerator

maintainers:
  - Stanimir Varbanov <stanimir.k.varbanov@gmail.com>
  - Vikash Garodia <quic_vgarodia@quicinc.com>

description: |
  Iris1 has a controller, one video codec engine (MVS0) and a computer
  vision engine (MVS1). All three power domains and their clocks are
  needed during firmware startup. MVS1 is not a second video codec core.

allOf:
  - $ref: qcom,venus-common.yaml#

properties:
  compatible:
    const: qcom,sc8180x-venus

  clocks:
    minItems: 7
    maxItems: 7

  clock-names:
    items:
      - const: core
      - const: iface
      - const: bus
      - const: vcodec0_core
      - const: vcodec0_bus
      - const: vcodec1_core
      - const: vcodec1_bus

  power-domains:
    minItems: 4
    maxItems: 4

  power-domain-names:
    items:
      - const: venus
      - const: vcodec0
      - const: vcodec1
      - const: mmcx

  resets:
    maxItems: 2

  reset-names:
    items:
      - const: bus
      - const: core

  iommus:
    maxItems: 1

  interconnects:
    maxItems: 2

  interconnect-names:
    items:
      - const: video-mem
      - const: cpu-cfg

  operating-points-v2: true

  opp-table:
    type: object

required:
  - compatible
  - power-domain-names
  - resets
  - reset-names
  - iommus
  - interconnects
  - interconnect-names
  - operating-points-v2

unevaluatedProperties: false

examples:
  - |
    #include <dt-bindings/clock/qcom,gcc-sc8180x.h>
    #include <dt-bindings/clock/qcom,videocc-sm8150.h>
    #include <dt-bindings/interconnect/qcom,sc8180x.h>
    #include <dt-bindings/interrupt-controller/arm-gic.h>
    #include <dt-bindings/power/qcom,rpmhpd.h>

    video-codec@aa00000 {
        compatible = "qcom,sc8180x-venus";
        reg = <0x0aa00000 0x100000>;
        interrupts = <GIC_SPI 174 IRQ_TYPE_LEVEL_HIGH>;
        clocks = <&videocc VIDEO_CC_MVSC_CORE_CLK>,
                 <&videocc VIDEO_CC_IRIS_AHB_CLK>,
                 <&gcc GCC_VIDEO_AXIC_CLK>,
                 <&videocc VIDEO_CC_MVS0_CORE_CLK>,
                 <&gcc GCC_VIDEO_AXI0_CLK>,
                 <&videocc VIDEO_CC_MVS1_CORE_CLK>,
                 <&gcc GCC_VIDEO_AXI1_CLK>;
        clock-names = "core", "iface", "bus", "vcodec0_core",
                      "vcodec0_bus", "vcodec1_core", "vcodec1_bus";
        power-domains = <&videocc VENUS_GDSC>,
                        <&videocc VCODEC0_GDSC>,
                        <&videocc VCODEC1_GDSC>,
                        <&rpmhpd SC8180X_MMCX>;
        power-domain-names = "venus", "vcodec0", "vcodec1", "mmcx";
        resets = <&gcc GCC_VIDEO_AXIC_CLK_BCR>,
                 <&videocc VIDEO_CC_MVSC_CORE_CLK_BCR>;
        reset-names = "bus", "core";
        interconnects = <&mmss_noc MASTER_VIDEO_P0 &mc_virt SLAVE_EBI_CH0>,
                        <&gem_noc MASTER_AMPSS_M0 &config_noc SLAVE_VENUS_CFG>;
        interconnect-names = "video-mem", "cpu-cfg";
        iommus = <&apps_smmu 0x2300 0x60>;
        memory-region = <&venus_mem>;
        operating-points-v2 = <&venus_opp_table>;
    };
```

## drivers/slimbus/Kconfig
```kconfig
# SPDX-License-Identifier: GPL-2.0
#
# SLIMbus driver configuration
#
menuconfig SLIMBUS
	tristate "SLIMbus support"
	help
	  SLIMbus is standard interface between System-on-Chip and audio codec,
	  and other peripheral components in typical embedded systems.

	  If unsure, choose N.

if SLIMBUS

# SLIMbus controllers
config SLIM_QCOM_NGD_CTRL
	tristate "Qualcomm SLIMbus Satellite Non-Generic Device Component"
	depends on HAS_IOMEM && DMA_ENGINE && NET
	depends on QCOM_RPROC_COMMON || (COMPILE_TEST && !QCOM_RPROC_COMMON)
	depends on ARCH_QCOM || COMPILE_TEST
	select QCOM_QMI_HELPERS
	select QCOM_PDR_HELPERS
	help
	  Select driver if Qualcomm's SLIMbus Satellite Non-Generic Device
	  Component is programmed using Linux kernel.
	  This is light-weight slimbus controller driver responsible for
	  communicating with slave HW directly over the bus using messaging
	  interface, and communicating with master component residing on ADSP
	  for bandwidth and data-channel management.

config SLIM_QCOM_NGD_QMI_PROBE
	tristate "Qualcomm SLIMbus QMI probe (diagnostic)"
	depends on SLIMBUS && QCOM_QMI_HELPERS
	help
	  Diagnostic module that exercises the same QMI / QRTR plumbing as
	  the SLIMbus child probe (qcom-ngd-ctrl.c), without touching the
	  SLIMbus / BAM MMIO. Used to bisect whether a hang in the audio
	  bring-up lives in the QRTR / QMI / PDR subsystem or in the
	  SLIMbus driver itself.

	  Stage 0: qmi_handle_init + qmi_add_lookup for the SLIMbus QMI
	           service 0x301, wait for new_server.
	  Stage 1: connect to the discovered service and send
	           SELECT_INSTANCE.
	  Stage 2: also send POWER_ACTIVE then POWER_INACTIVE so the ADSP
	           is left in the same state it was in before the probe.

	  Safe to load/unload without affecting the audio driver.
endif
```

## drivers/spx_extras/Kconfig
```kconfig
config SPX_SWR_DIRECT
	tristate "SPX direct SWR master drive (debug only)"
	help
	  Direct regmap drive of the WCD9340 codec's internal SoundWire master.
	  Debug/experimental only.
```

## drivers/ufs/core/Kconfig
```kconfig
# SPDX-License-Identifier: GPL-2.0+
#
# Kernel configuration file for the UFS Host Controller core.
#
# Copyright (C) 2011-2013 Samsung India Software Operations
#
# Authors:
#	Santosh Yaraganavi <santosh.sy@samsung.com>
#	Vinayak Holikatti <h.vinayak@samsung.com>

config SCSI_UFS_BSG
	bool "Universal Flash Storage BSG device node"
	select BLK_DEV_BSGLIB
	help
	  Universal Flash Storage (UFS) is SCSI transport specification for
	  accessing flash storage on digital cameras, mobile phones and
	  consumer electronic devices.
	  A UFS controller communicates with a UFS device by exchanging
	  UFS Protocol Information Units (UPIUs).
	  UPIUs can not only be used as a transport layer for the SCSI protocol
	  but are also used by the UFS native command set.
	  This transport driver supports exchanging UFS protocol information units
	  with a UFS device. See also the ufshcd driver, which is a SCSI driver
	  that supports UFS devices.

	  Select this if you need a bsg device node for your UFS controller.
	  If unsure, say N.

config SCSI_UFS_CRYPTO
	bool "UFS Crypto Engine Support"
	depends on BLK_INLINE_ENCRYPTION
	help
	  Enable Crypto Engine Support in UFS.
	  Enabling this makes it possible for the kernel to use the crypto
	  capabilities of the UFS device (if present) to perform crypto
	  operations on data being transferred to/from the device.

config SCSI_UFS_FAULT_INJECTION
	bool "UFS Fault Injection Support"
	depends on FAULT_INJECTION
	help
	  Enable fault injection support in the UFS driver. This makes it easier
	  to test the UFS error handler and abort handler.

config SCSI_UFS_HWMON
	bool "UFS Temperature Notification"
	depends on SCSI_UFSHCD=HWMON || HWMON=y
	help
	  This provides support for UFS hardware monitoring. If enabled,
	  a hardware monitoring device will be created for the UFS device.

	  If unsure, say N.

config SCSI_UFS_HPB
	bool "UFS Host Performance Booster (HPB) support"
	depends on SCSI_UFSHCD
	help
	  Enable Host Performance Booster (HPB) support for UFS 3.1 devices.

	  HPB is a JEDEC UFS 3.1 feature (HPB version 2.0) that caches logical
	  block address (LBA) to physical page number (PPN) mappings in host
	  memory. By supplying the PPN directly in the HPB READ command CDB
	  (opcode 0xF8), the device can skip its internal L2P table lookup,
	  improving random read IOPS by 2-3x on supported hardware.

	  The feature is enabled per host controller via UFSHCD_CAP_HPB_EN
	  in the host driver. HPB is automatically disabled for devices that
	  do not report UFS_DEV_HPB_SUPPORT in their device descriptor.

	  This option is required for full storage performance on the Microsoft
	  Surface Pro X (Qualcomm SC8180X) whose UFS 3.1 device supports HPB.

	  NOTE: This implementation is currently a scaffolding stub. The data
	  structures, Kconfig entry, and module skeleton are in place but the
	  HPB READ command injection and region-management logic are not yet
	  complete. See drivers/ufs/core/ufshpb.c for details.

	  If unsure, say N.
```
