// SPDX-License-Identifier: GPL-2.0
/*
 * SPX pre-audit speaker DTS.  Identical to the audited speaker-left DTS except
 * that it omits the routing block cfc49f4bed61 added -- the `&swm 0` entry in
 * the playback DAI link's sound-dai list and the whole audio-routing table.
 * That block landed at the start of the silent era and has never been shown
 * audible, so this DTB isolates it as a single variable.  The watchdog node is
 * retained because the guarded harness requires /dev/watchdog0.
 */

/*
 * Conservative speaker test: retain the stock reserved-memory layout and
 * expose one logical WSA881x slave to ASoC. Both physical amplifiers share
 * the bus and receive device number 1, but only one Linux codec component is
 * needed to configure the SoundWire stream and PA path.
 */
#include "sc8180x-surface-pro-x.dts"

/*
 * Keep the hardware watchdog available during the guarded speaker test. This
 * node is byte-for-byte equivalent to the watchdog used by the proven camera
 * test DTBs; the common SC8180X DTS currently omits it.
 */
&soc {
	watchdog@17c10000 {
		compatible = "qcom,apss-wdt-sm8150", "qcom,kpss-wdt";
		reg = <0 0x17c10000 0 0x1000>;
		clocks = <&sleep_clk>;
		interrupts = <GIC_SPI 0 IRQ_TYPE_EDGE_RISING>;
	};
};

&right_spkr {
	status = "disabled";
};

/*
 * SPX: the codec-internal SWR master IRQ is needed for the bus to
 * function. On Jun 29 the bus worked with the IRQ present (dtb.wsairq).
 * Without it, MCP_SLV_STATUS stays 0x0 on every boot. The force-attach
 * code now masks interrupts during the critical section (spx_blind_attach
 * + interrupt CPU_EN/mask writes), so the ISR no longer corrupts the
 * CMD FIFO.
 */
