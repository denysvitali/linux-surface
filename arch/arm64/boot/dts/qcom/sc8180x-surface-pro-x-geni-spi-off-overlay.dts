/dts-v1/;
/plugin/;

/*
 * Early-boot isolation image for the Surface Pro X mainline bring-up.
 * The two enabled QUP0 SPI engines are the Surface HID bus and the WCD9340
 * WDSP bus.  Disable both child engines so the built-in GENI SPI runtime-PM
 * path cannot enter its RPMh/ICC suspend sequence during this test.
 */
&{/soc@0/geniqup@8c0000/spi@884000} {
	status = "disabled";
};

&{/soc@0/geniqup@8c0000/spi@88c000} {
	status = "disabled";
};
